## conf/machine/icorem6dual.conf
```bitbake
#@TYPE: Machine
#@NAME: Space Carrier Board 20010 with Engicam iCoreM6 Dual SoC
#@SOC: i.MX6Q
#@DESCRIPTION: Machine configuration for Space Carrier Board 20010

require conf/machine/include/iCoreM6.inc

SOC_FAMILY = "mx6:mx6q"

UBINIZE_ARGS = "-m 2048 -p 128KiB -s 2048"
MKUBIFS_ARGS = "-m 2048 -e 126976 -c 1944"
UBI_VOLNAME = "rootfs"

KERNEL_DEVICETREE = "imx6q-space20010.dtb"

PREFERRED_PROVIDER_u-boot = "u-boot-imx"
PREFERRED_PROVIDER_virtual/bootloader = "u-boot-imx"

UBOOT_CONFIG[sd] = "mx6d_icore_sd_config,sdcard" 
UBOOT_CONFIG[nand] = "mx6d_icore_config,ubifs"
```

## conf/machine/space20010m6dual.conf
```bitbake
#@TYPE: Machine
#@NAME: Space Carrier Board 20010 with Engicam iCoreM6 Dual SoC
#@SOC: i.MX6Q
#@DESCRIPTION: Machine configuration for Space Carrier Board 20010

require conf/machine/include/iCoreM6.inc

SOC_FAMILY = "mx6:mx6q"

MKUBIFS_ARGS = "-m 4096 -e 253952 -c 1996"
UBINIZE_ARGS = "-m 4096 -p 262144 -s 4096"
UBI_VOLNAME = "rootfs"

KERNEL_DEVICETREE = "imx6q-space20010.dtb"

PREFERRED_PROVIDER_u-boot = "u-boot-imx"
PREFERRED_PROVIDER_virtual/bootloader = "u-boot-imx"

UBOOT_CONFIG[sd] = "mx6d_icore_sd_config,sdcard" 
UBOOT_CONFIG[nand] = "mx6d_icore_config,ubifs"

PREFERRED_PROVIDER_jpeg = "jpeg"
```
